## build/conf/bblayers.conf
```bitbake
# LAYER_CONF_VERSION is increased each time build/conf/bblayers.conf
# changes incompatibly
LCONF_VERSION = "6"

BBPATH = "${TOPDIR}"
BBFILES ?= ""

BBLAYERS ?= " \
  ${TOPDIR}/../meta \
  ${TOPDIR}/../meta-yocto \
  ${TOPDIR}/../meta-yocto-bsp \
  ${TOPDIR}/../meta-fsl-arm \
  ${TOPDIR}/../meta-solidrun-arm-imx6 \
  ${TOPDIR}/../meta-inspectron \
  ${TOPDIR}/../meta-qt5 \
  ${TOPDIR}/../meta-openembedded/meta-oe \
  ${TOPDIR}/../meta-openembedded/meta-python \
  ${TOPDIR}/../meta-openembedded/meta-networking \
  "
BBLAYERS_NON_REMOVABLE ?= " \
  ${TOPDIR}/../meta \
  ${TOPDIR}/../meta-yocto \
  "

#BBLAYERS += " ${TOPDIR}/../meta-openembedded/meta-gnome "
#BBLAYERS += " ${TOPDIR}/../meta-openembedded/meta-xfce "
BBLAYERS += " ${TOPDIR}/../meta-openembedded/meta-ruby "

# jan 31 2022. not really needed anymore??
#  ${TOPDIR}/../meta-wireless-handle
#  ${TOPDIR}/../meta-ti
```

## build/conf/local.conf
```bitbake
MACHINE ??= "inspectron-itb200"
DISTRO ?= "poky"
PACKAGE_CLASSES ?= "package_rpm"
USER_CLASSES ?= "buildstats image-mklibs image-prelink"
PATCHRESOLVE = "noop"
BB_DISKMON_DIRS = "\
    STOPTASKS,${TMPDIR},1G,100K \
    STOPTASKS,${DL_DIR},1G,100K \
    STOPTASKS,${SSTATE_DIR},1G,100K \
    ABORT,${TMPDIR},100M,1K \
    ABORT,${DL_DIR},100M,1K \
    ABORT,${SSTATE_DIR},100M,1K" 
PACKAGECONFIG_append_pn-qemu-native = " sdl"
PACKAGECONFIG_append_pn-nativesdk-qemu = " sdl"
CONF_VERSION = "1"

INHERIT += "archiver"
ACHIVER_MODE[src] = "original"

# add user functionality
INHERIT += "extrausers"

BB_NUMBER_THREADS = '8'
PARALLEL_MAKE = '-j 8'

DL_DIR ?= "${TOPDIR}/downloads"

ACCEPT_FSL_EULA = ""

#LICENSE_FLAGS_WHITELIST = "commercial"
PREFERRED_PROVIDER_jpeg = "libjpeg-turbo"
PREFERRED_PROVIDER_jpeg-native = "libjpeg-turbo-native"

PREFERRED_VERSION_bash = "3.2.48"
PREFERRED_VERSION_readline = "5.2"
IMAGE_INSTALL_remove += "elfutils"

# add a 256 MBytes to the rootfs
IMAGE_ROOTFS_EXTRA_SPACE = "262144"

DISTRO_FEATURES_remove = " x11 wayland directfb"

IMAGE_INSTALL_append = " \
            openssh-sftp-server \
		    i2c-tools \
		    iw \
		    update-rc.d \
			dhcp-client \
		    hostapd \
			dnsmasq \
		    lighttpd \
			php \
			php-cgi \
			linux-firmware-wl18xx \
            v4l-utils \
            "
#
# FOR DESKTOP DISTROBUTIONS
#
#EXTRA_IMAGE_FEATURES = " splash"
#REQUIRED_DISTRO_FEATURES = "x11"
#IMAGE_INSTALL_append = " \
#		        packagegroup-core-x11 \
#			packagegroup-xfce-base \
#			evince \
#			claws-mail \
#                       "

# needed for qtquickcontrols
PACKAGECONFIG_append_pn-qtbase = " accessibility"
PACKAGECONFIG_append_pn-qtbase = " sql-sqlite"
```
